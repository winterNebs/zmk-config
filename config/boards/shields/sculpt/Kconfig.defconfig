## config/boards/shields/sculpt/Kconfig.defconfig
```kconfig
# Copyright (c) 2020 The ZMK Contributors
# SPDX-License-Identifier: MIT

if SHIELD_SCULPT_LEFT

config ZMK_KEYBOARD_NAME
	default "sculpt"

config ZMK_SPLIT_BLE_ROLE_CENTRAL
	default y

endif

if SHIELD_SCULPT_LEFT || SHIELD_SCULPT_RIGHT

config ZMK_SPLIT
	default y

endif

CONFIG_ZMK_KSCAN_DEBOUNCE_PRESS_MS=0
CONFIG_USB_HID_POLL_INTERVAL_MS=1


CONFIG_BUILD_OUTPUT_UF2=y
```

## config/boards/shields/sculpt/Kconfig.shield
```kconfig
# Copyright (c) 2020 The ZMK Contributors
# SPDX-License-Identifier: MIT

config SHIELD_SCULPT_LEFT
	def_bool $(shields_list_contains,sculpt_left)

config SHIELD_SCULPT_RIGHT
	def_bool $(shields_list_contains,sculpt_right)
```
